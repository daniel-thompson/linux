## Documentation/devicetree/bindings/reset/toshiba,tc9564-reset.yaml
```yaml
# SPDX-License-Identifier: (GPL-2.0-only OR BSD-2-Clause)
%YAML 1.2
---
$id: http://devicetree.org/schemas/reset/toshiba,tc9564-reset.yaml#
$schema: http://devicetree.org/meta-schemas/core.yaml#

title: Toshiba TC9564 Reset Controller

maintainers:
  - Alex Elder <elder@riscstar.com>
  - Daniel Thompson <daniel@riscstar.com>

description: |
  The Toshiba TC9564 is an SoC accessed by a host system through the
  upstream PCIe port on the PCIe switch it implements.  The switch
  includes an embedded PCIe endpoint that provides access to various
  SoC peripherals (including a reset controller) via its BARs.

  The SoC is represented using a devicetree PCI endpoint bus, so the
  reset controller is bound to its driver using its platform driver
  compatible string.

  A total of thirteen resets are implemented, though the PCIe reset
  cannot be asserted (because the reset block depends on PCIe).  The
  PCIe subsystem depends on the I2C block as well, so access to the
  I2C reset is also not provided.

  A system controller coordinates access to the two registers that
  manage the reset states (RSTCTRL0 and RSTCTRL1).

  Reset ids are defined in <dt-bindings/reset/toshiba,tc9564.h>.

properties:
  compatible:
    const: toshiba,tc9564-reset

  reg:
    items:
      - description: Offset and size of RSTCTRL0 register
      - description: Offset and size of RSTCTRL1 register

  "#reset-cells":
    const: 1

required:
  - compatible
  - reg
  - "#reset-cells"

unevaluatedProperties: false

examples:
  - |
    #include <dt-bindings/reset/toshiba,tc9564.h>

    reset@1008 {
        compatible = "toshiba,tc9564-reset";
        reg = <0x1008 0x4>, <0x1010 0x4>;
        #reset-cells = <1>;
    };
```

## drivers/net/ethernet/toshiba/tc956x/Kconfig
```kconfig
# SPDX-License-Identifier: GPL-2.0-only
#
# Toshiba TC956x configuration
#

config TC956X_NET
	tristate "TC956x/QPS615 Ethernet driver"
	depends on PCI
	help
	  This driver supports the TC965x/QPS615 ethernet audio-video bridging
	  (AVB)/time-sensitive networking (TSN) bridge.


if TC956X_NET

config TC956X_PCIE_GEN3_SETTING
	bool "PCIe gen3 setting"

config TC956X_LOAD_FW_HEADER
	depends on BROKEN  # No fw.h supplied
	bool "Load firmware header (fw.h)"

config TC956X_IOCTL_REG_RD_WR_ENABLE
	bool "Enable ioctl register read/write"

config TC956X_MAGIC_PACKET_WOL_GPIO
	bool "Enable magic packet WoL GPIO"

config TC956X_MAGIC_PACKET_WOL_CONF
	bool "Enable magic packet WoL configuration"

config TC956X_DMA_OFFLOAD_ENABLE
	bool "Enable DMA offload"

config TC965X_SPIOV_VF
	depends on BROKEN  # Tries to build code that has not beeen ported to v6.6
	bool "Enable SPIOV VF"

# Skip PF/CPE/port-bridge/automotive for now

# Skip DMA_OFFLOAD (which is different from TC956X_DMA_OFFLOAD_ENABLE
# and looks like it controls whether or not dead code is compiled).

config TC956X_MAC_SELFTESTS
	bool "Enable MAC self tests"

endif # TC956X_NET
```
