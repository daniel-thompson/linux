## Documentation/devicetree/bindings/clock/toshiba,tc9564-clock.yaml
```yaml
# SPDX-License-Identifier: (GPL-2.0-only OR BSD-2-Clause)
%YAML 1.2
---
$id: http://devicetree.org/schemas/clock/toshiba,tc9564-clock.yaml#
$schema: http://devicetree.org/meta-schemas/core.yaml#

title: Toshiba TC9564 Reset Controller

maintainers:
  - Alex Elder <elder@riscstar.com>
  - Daniel Thompson <daniel@riscstar.com>

description: |
  The Toshiba TC9564 is an SoC accessed by a host system through the
  upstream PCIe port on the PCIe switch it implements.  The switch
  includes an embedded PCIe endpoint that provides access to various
  SoC peripherals (including a clock controller) via its BARs.

  The SoC is represented using a devicetree PCI endpoint bus, so the
  clock controller is bound to its driver using its platform driver
  compatible string.  All of these clocks are simple gate clocks.

  A total of 21 clocks are implemented, though the PCIe clock cannot
  be disabled (because the clock controller depends on PCIe).  The
  PCIe subsystem depends on the I2C block as well, so the I2C clock
  is cannot be disabled.

  A system controller coordinates access to the two registers that
  manage the clock states (CLKCTRL0 and CLKCTRL1).

  Clock ids are defined in <dt-bindings/clock/toshiba,tc9564.h>.

properties:
  compatible:
    const: toshiba,tc9564-clock

  reg:
    items:
      - description: Offset and size of CLKCTRL0 register
      - description: Offset and size of CLKCTRL1 register

  "#clock-cells":
    const: 1

required:
  - compatible
  - reg
  - "#clock-cells"

unevaluatedProperties: false

examples:
  - |
    #include <dt-bindings/clock/toshiba,tc9564.h>

    clock@1004 {
        compatible = "toshiba,tc9564-clock";
        reg = <0x1004 0x4>, <0x100c 0x4>;
        #clock-cells = <1>;
    };
```

## Documentation/devicetree/bindings/gpio/toshiba,tc9564-gpio.yaml
```yaml
# SPDX-License-Identifier: (GPL-2.0-only OR BSD-2-Clause)
%YAML 1.2
---
$id: http://devicetree.org/schemas/gpio/toshiba,tc9564-gpio.yaml#
$schema: http://devicetree.org/meta-schemas/core.yaml#

title: Toshiba TC9564 GPIO Controller

maintainers:
  - Alex Elder <elder@riscstar.com>
  - Daniel Thompson <daniel@riscstar.com>

description: |
  The TC9564 implements 37 GPIO lines (GPIOs 0-36).  GPIOs 20 and 21
  are reserved.  GPIOs 2 and 3 are reserved for use by the PCI power
  control driver.  GPIOs 22, 23, 24, 27, 28, 31, and 34 are input-only.

  The GPIO controller registers are accessed through the parent
  "toshiba,tc9564-config" syscon regmap.

properties:
  compatible:
    const: toshiba,tc9564-gpio

  gpio-controller: true

  "#gpio-cells":
    const: 2

  gpio-ranges:
    maxItems: 1

required:
  - compatible
  - gpio-controller
  - "#gpio-cells"

unevaluatedProperties: false

examples:
  - |
    gpio {
        compatible = "toshiba,tc9564-gpio";
        gpio-controller;
        #gpio-cells = <2>;
    };
```

## Documentation/devicetree/bindings/mfd/toshiba,tc9564.yaml
```yaml
# SPDX-License-Identifier: (GPL-2.0-only OR BSD-2-Clause)
%YAML 1.2
---
$id: http://devicetree.org/schemas/mfd/toshiba,tc9564.yaml#
$schema: http://devicetree.org/meta-schemas/core.yaml#

title: Toshiba TC9564 System Controllers

maintainers:
  - Alex Elder <elder@riscstar.com>
  - Daniel Thompson <daniel@riscstar.com>

description: |
  The Toshiba TC9564 is an SoC accessed by a host system through the
  upstream PCIe port on the PCIe switch it implements.  The switch
  includes an embedded PCIe endpoint that provides access to various
  SoC peripherals (including a reset controller) via its BARs.

  Two system controllers manage access to memory regions that are
  shared by drivers for multiple devices.

properties:
  compatible:
    items:
      - enum:
          - toshiba,tc9564-bridge
          - toshiba,tc9564-config
      - const: syscon
      - const: simple-mfd

  reg:
    maxItems: 1

  ranges: true

  '#address-cells':
    const: 1

  '#size-cells':
    const: 1

required:
  - compatible
  - reg

unevaluatedProperties: false

examples:
  - |
    syscon@0 {
        compatible = "toshiba,tc9564-config",
                     "syscon",
                     "simple-mfd";
        reg = <0x0 0x2000>;
        #address-cells = <1>;
        #size-cells = <1>;
        ranges;
    };
```

## Documentation/devicetree/bindings/misc/toshiba,tc9564-translate.yaml
```yaml
# SPDX-License-Identifier: (GPL-2.0-only OR BSD-2-Clause)
%YAML 1.2
---
$id: http://devicetree.org/schemas/misc/toshiba,tc9564-translate.yaml#
$schema: http://devicetree.org/meta-schemas/core.yaml#

title: Toshiba TC9564 Address Translation Unit

maintainers:
  - Alex Elder <elder@riscstar.com>
  - Daniel Thompson <daniel@riscstar.com>

description: |
  The Toshiba TC9564 is an SoC accessed by a host system through the
  upstream PCIe port on the PCIe switch it implements.  The switch
  includes an embedded PCIe endpoint that provides access to various
  SoC peripherals (including an AXI-to-PCIe address translation unit)
  via its BARs.

  The SoC is represented using a devicetree PCI endpoint bus, so the
  address translation unit is bound to its driver using its platform
  driver compatible string.

  Four available translation table entries specify an internal AXI
  bus source address, a PCIe bus translated address, and size of a
  region of memory to be translated.  The Ethernet MACs on the TC9564
  access the PCIe subsystem via this bus.

properties:
  compatible:
    const: toshiba,tc9564-translate

  reg:
    items:
      - description: Offset and size of translation table memory

required:
  - compatible
  - reg

unevaluatedProperties: false

examples:
  - |
    translate@800 {
        compatible = "toshiba,tc9564-translate";
        reg = <0x0800 0x80>;
    };
```

## Documentation/devicetree/bindings/net/toshiba,tc9564-dwmac.yaml
```yaml
# SPDX-License-Identifier: (GPL-2.0-only OR BSD-2-Clause)
%YAML 1.2
---
$id: http://devicetree.org/schemas/net/toshiba,tc9564-dwmac.yaml#
$schema: http://devicetree.org/meta-schemas/core.yaml#

title: Toshiba TC9564 XGMAC Ethernet Controller

maintainers:
  - Alex Elder <elder@riscstar.com>
  - Daniel Thompson <daniel@riscstar.com>

description: |
  The Toshiba TC9564 (and more generally, TC9564) incorporates a PCIe
  gen 3 switch with one upstream and three downstream ports.  The first
  two downstream ports are exposed externally, while the third is used
  by an internal PCIe endpoint.  The PCIe endpoint implements two PCIe
  functions, and attached to each of these is a 10 Gbps capable Synopsys
  XGMAC Ethernet controller.

  The TC9564 additionally implements other internal IP blocks, and in
  particular it implements a GPIO controller.  Ten of the 35 GPIO lines
  implemented are exposed externally and are usable by the platform.
  It is platform-dependent whether the GPIO function must be exposed,
  and if it is, PCIe function 0 supplies it.

              ----------------------------------
              |              Host              |
              ------+...+----------+........+---
                    |i2c|          |  PCIe  |
    ----------------+...+----------+........+------
    | TC9564        |I2C|          |upstream|     |
    |               -----        --+--------+---  |
    |  -----  ------  -------    | PCIe switch |  |
    |  |SPI|  |GPIO|  |reset|    |             |  |
    |  -----  ------  |clock|    | DS3 DS2 DS1 |  |
    |                 -------    ---++--++--++--  |
    |  -----  ------     downstream//    \\  \\   |  downstream
    |  |MCU|  |SRAM|    /==========/      \\  \===== PCIe port 1
    |  -----  ------   //PCIe port 3       \\     |
    |                  ||                   \======= downstream
    |  ----+-----------++-----------+----         |  PCIe port 2
    |  | M | internal PCIe endpoint | M |         |
    |  | S |------------------------| S |  ------ |
    |  | I |   PCIe   |  |   PCIe   | I |  |UART| |
    |  | G |function 0|  |function 1| G |  ------ |
    |  | E |----++----|  |----++----| E |         |
    |  | N |  eMAC 0  |  |  eMAC 1  | N |         |
    --------+.......+------+.....+-----------------
            |USXGMII|      |SGMII|
          --+.......+--  --+.....+--
          |  ARQ113C  |  | QEP8121 |
          |    PHY    |  |   PHY   |
          -------------  -----------

select:
  properties:
    compatible:
      contains:
        const: toshiba,tc9564-xgmac
  required:
    - compatible

allOf:
  - $ref: snps,dwmac.yaml#

properties:
  compatible:
    const: toshiba,tc9564-xgmac

  reg:
    maxItems: 1

  toshiba,config-syscon:
    $ref: /schemas/types.yaml#/definitions/phandle-array
    description:
      Phandle to the TC9564 config system controller plus an offset
      argument giving the EMAC control register offset within the
      regmap.  The config syscon has compatible
      "toshiba,tc9564-config".
    items:
      - items:
          - description: Phandle to the config syscon
          - description: Offset of the EMAC control register

  clocks:
    minItems: 5
    maxItems: 6
    items:
      - description: MAC main clock (125 MHz)
      - description: PTP reference clock (250 MHz)
      - description: MAC TX clock
      - description: MAC RX clock
      - description: MAC all clock gate
      - description: MAC RMII clock (function 1 only)

  clock-names:
    minItems: 5
    maxItems: 6
    items:
      - const: stmmaceth
      - const: ptp_ref
      - const: mac-tx-clock
      - const: mac-rx-clock
      - const: mac-all-clock
      - const: mac-rmii-clock

  resets:
    items:
      - description: MAC reset
      - description: PMA (Physical Medium Attachment) reset
      - description: XPCS reset

  reset-names:
    items:
      - const: mac-reset
      - const: pma-reset
      - const: xpcs-reset

  interrupts:
    minItems: 17
    maxItems: 17

  interrupt-names:
    items:
      - const: macirq
      - const: tx-queue-0
      - const: tx-queue-1
      - const: tx-queue-2
      - const: tx-queue-3
      - const: tx-queue-4
      - const: tx-queue-5
      - const: tx-queue-6
      - const: tx-queue-7
      - const: rx-queue-0
      - const: rx-queue-1
      - const: rx-queue-2
      - const: rx-queue-3
      - const: rx-queue-4
      - const: rx-queue-5
      - const: rx-queue-6
      - const: rx-queue-7

  rx-fifo-depth:
    $ref: /schemas/types.yaml#/definitions/uint32
    description:
      RX FIFO size in bytes.  Must be set explicitly because the
      hardware FIFO size register uses powers of two, preventing
      the core driver from auto-detecting the actual size.
      Maximum value is 47104 (46 KiB).

  tx-fifo-depth:
    $ref: /schemas/types.yaml#/definitions/uint32
    description:
      TX FIFO size in bytes.  Must be set explicitly because the
      hardware FIFO size register uses powers of two, preventing
      the core driver from auto-detecting the actual size.
      Maximum value is 47104 (46 KiB).

required:
  - compatible
  - reg
  - toshiba,config-syscon
  - clocks
  - clock-names
  - resets
  - reset-names
  - interrupts
  - interrupt-names
  - rx-fifo-depth
  - tx-fifo-depth

unevaluatedProperties: false

examples:
  - |
    #include <dt-bindings/clock/toshiba,tc9564.h>
    #include <dt-bindings/reset/toshiba,tc9564.h>

    ethernet@40000 {
        compatible = "toshiba,tc9564-xgmac";
        reg = <0x40000 0x8000>;
        toshiba,config-syscon = <&config_syscon 0x1070>;

        clocks = <&ref_125mhz_clk>,
                 <&ref_250mhz_clk>,
                 <&clock0 CLOCK_MAC0_TX>,
                 <&clock0 CLOCK_MAC0_RX>,
                 <&clock0 CLOCK_MAC0_ALL>;
        clock-names = "stmmaceth",
                      "ptp_ref",
                      "mac-tx-clock",
                      "mac-rx-clock",
                      "mac-all-clock";

        resets = <&reset0 RESET_MAC0_MAC>,
                 <&reset0 RESET_MAC0_PMA>,
                 <&reset0 RESET_MAC0_XPCS>;
        reset-names = "mac-reset",
                      "pma-reset",
                      "xpcs-reset";

        interrupts-extended = <&msigen0 2>,
                              <&msigen0 3>,
                              <&msigen0 4>,
                              <&msigen0 5>,
                              <&msigen0 6>,
                              <&msigen0 7>,
                              <&msigen0 8>,
                              <&msigen0 9>,
                              <&msigen0 10>,
                              <&msigen0 11>,
                              <&msigen0 12>,
                              <&msigen0 13>,
                              <&msigen0 14>,
                              <&msigen0 15>,
                              <&msigen0 16>,
                              <&msigen0 17>,
                              <&msigen0 18>;
        interrupt-names = "macirq",
                          "tx-queue-0",
                          "tx-queue-1",
                          "tx-queue-2",
                          "tx-queue-3",
                          "tx-queue-4",
                          "tx-queue-5",
                          "tx-queue-6",
                          "tx-queue-7",
                          "rx-queue-0",
                          "rx-queue-1",
                          "rx-queue-2",
                          "rx-queue-3",
                          "rx-queue-4",
                          "rx-queue-5",
                          "rx-queue-6",
                          "rx-queue-7";

        rx-fifo-depth = <32768>;
        tx-fifo-depth = <32768>;

        snps,tso;
        snps,pbl = <32>;
        snps,force_sf_dma_mode;
        snps,perfect-filter-entries = <32>;

        phy-mode = "10gbase-r";
        phy-handle = <&emac0_phy>;

        snps,axi-config = <&axi_emac0_setup>;

        snps,mtl-rx-config = <&mtl_rx_emac0_setup>;
        snps,mtl-tx-config = <&mtl_tx_emac0_setup>;

        mdio {
            compatible = "snps,dwmac-mdio";
            #address-cells = <1>;
            #size-cells = <0>;

            emac0_phy: ethernet-phy@1c {
                compatible = "ethernet-phy-id311c.1c12";
                reg = <0x1c>;
            };
        };

        axi_emac0_setup: stmmac-axi-config {
            snps,lpi_en;
            snps,wr_osr_lmt = <31>;
            snps,rd_osr_lmt = <31>;
            snps,blen = <256 128 64 32 16 8 4>;
        };

        mtl_rx_emac0_setup: rx-queues-config {
            snps,rx-queues-to-use = <4>;
            snps,rx-sched-sp;
            queue0 {
                snps,dcb-algorithm;
                snps,map-to-dma-channel = <0x0>;
            };
            queue1 {
                snps,dcb-algorithm;
                snps,map-to-dma-channel = <0x1>;
            };
            queue2 {
                snps,dcb-algorithm;
                snps,map-to-dma-channel = <0x2>;
            };
            queue3 {
                snps,dcb-algorithm;
                snps,map-to-dma-channel = <0x3>;
            };
        };

        mtl_tx_emac0_setup: tx-queues-config {
            snps,tx-queues-to-use = <4>;
            snps,tx-sched-wrr;
            queue0 {
                snps,weight = <0x0c>;
                snps,dcb-algorithm;
            };
            queue1 {
                snps,weight = <0x0c>;
                snps,dcb-algorithm;
            };
            queue2 {
                snps,weight = <0x0c>;
                snps,dcb-algorithm;
            };
            queue3 {
                snps,weight = <0x0c>;
                snps,dcb-algorithm;
            };
        };
    };
```
