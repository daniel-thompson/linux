## Documentation/devicetree/bindings/power/supply/cw2015_battery.txt
```
cw2015_battery
~~~~~~~~~~~~~~~~

The cellwise CW2015 is a shuntless single cell battery fuel gauge.

Required properties :
 - compatible : "cellwise,cw2015"
 - reg: i2c address

Optional properties :
 - cellwise,bat-config-info : 64 byte binary battery info blob
 - cellwise,monitor-interval-ms : Measurement interval in milliseconds
 - power-supplies: List of phandles from chargers
 - monitored-battery: phandle of a simpl-battery

Example:
	bat: battery {
		compatible = "simple-battery";
		voltage-min-design-microvolt = <3000000>;
		voltage-max-design-microvolt = <4350000>;
		charge-full-design-microamp-hours = <9800000>;
	}

	cw2015@62 {
		compatible = "cellwise,cw201x";
		reg = <0x62>;
		cellwise,bat-config-info = /bits/ 8 <
			0x17 0x67 0x80 0x73 0x6E 0x6C 0x6B 0x63
			0x77 0x51 0x5C 0x58 0x50 0x4C 0x48 0x36
			0x15 0x0C 0x0C 0x19 0x5B 0x7D 0x6F 0x69
			0x69 0x5B 0x0C 0x29 0x20 0x40 0x52 0x59
			0x57 0x56 0x54 0x4F 0x3B 0x1F 0x7F 0x17
			0x06 0x1A 0x30 0x5A 0x85 0x93 0x96 0x2D
			0x48 0x77 0x9C 0xB3 0x80 0x52 0x94 0xCB
			0x2F 0x00 0x64 0xA5 0xB5 0x11 0xF0 0x11
		>;
		cellwise,monitor-interval-ms = <5000>;
		power-supplies = <&mains_charger>, <&usb_charger>;
		monitored-battery = <&bat>;
	}
```

## Documentation/devicetree/bindings/serial/st,stm32-usart.txt
```
* STMicroelectronics STM32 USART

Required properties:
- compatible: Can be either "st,stm32-usart" or "st,stm32-uart" depending on
whether the device supports synchronous mode.
- reg: The address and length of the peripheral registers space
- interrupts: The interrupt line of the USART instance
- clocks: The input clock of the USART instance

Optional properties:
- pinctrl: The reference on the pins configuration
- auto-flow-control: bool flag to enable hardware flow control.

Examples:
usart4: serial@40004c00 {
	compatible = "st,stm32-uart";
	reg = <0x40004c00 0x400>;
	interrupts = <52>;
	clocks = <&clk_pclk1>;
	pinctrl-names = "default";
	pinctrl-0 = <&pinctrl_usart4>;
};

usart2: serial@40004400 {
	compatible = "st,stm32-usart", "st,stm32-uart";
	reg = <0x40004400 0x400>;
	interrupts = <38>;
	clocks = <&clk_pclk1>;
	auto-flow-control;
	pinctrl-names = "default";
	pinctrl-0 = <&pinctrl_usart2 &pinctrl_usart2_rtscts>;
};
```
