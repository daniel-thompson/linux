// SPDX-License-Identifier: GPL-2.0

/*
 * Devicetree overlay for the TC9564 SoC.  This overlay defines the PCI
 * endpoint bus provided by function 1 of the embedded PCIe endpoint.
 */

/dts-v1/;
/plugin/;

#include <dt-bindings/interrupt-controller/irq.h>
#include <dt-bindings/gpio/gpio.h>
#include <dt-bindings/clock/toshiba,tc9564.h>
#include <dt-bindings/reset/toshiba,tc9564.h>
/ {
	fragment@1 {
		target-path = "";

		__overlay__ {
			#address-cells = <3>;
			#size-cells = <2>;

			#interrupt-cells = <1>;
			interrupt-controller;

			pci-ep-bus@4 {
				compatible = "simple-bus";
				#address-cells = <1>;
				#size-cells = <1>;
				/* Map 0x0-0x1fffff to BAR 4 */
				// ranges = <0x0  0x4 0x0 0x0  0x200000>;
				// ranges = <0x0  0x0200001c 0x0 0x0  0x200000>;
				ranges = <0x40000000  0x02050100 0x0 0x40c00000  0x200000>;

				tc9564_msigen1: interrupt-controller@4000f100 {
					compatible = "toshiba,tc956x-msigen";
					reg = <0x4000f100 0x0100>;
					interrupt-controller;
					#interrupt-cells = <1>;

					interrupts = <0>;

					clocks = <&tc9564_clock0 CLOCK_MSIGEN>;
					clock-names = "toshiba,tc956x-msigen-clock";
					resets = <&tc9564_reset0 RESET_MSIGEN>;
					reset-names = "toshiba,tc956x-msigen-reset";
				};

				ethernet@40048000 {
					compatible = "toshiba,tc9564-xgmac",
						     "snps,dwxgmac-3.01",
						     "snps,dwxgmac";
					reg = <0x40048000 0x8000>;
					toshiba,config-syscon = <&config_syscon0 0x1074>;

					clocks = <&tc9564_clock0 CLOCK_MAC1_TX>,
						 <&tc9564_clock0 CLOCK_MAC1_RX>,
						 <&tc9564_clock0 CLOCK_MAC1_ALL>,
						 <&tc9564_clock0 CLOCK_MAC1_RMII>;
					clock-names = "toshiba,tc956x-mac-tx-clock",
						      "toshiba,tc956x-mac-rx-clock",
						      "toshiba,tc956x-mac-all-clock",
						      "toshiba,tc956x-mac-rmii-clock";

					resets = <&tc9564_reset0 RESET_MAC1_MAC>,
						 <&tc9564_reset0 RESET_MAC1_PMA>,
						 <&tc9564_reset0 RESET_MAC1_XPCS>;
					reset-names = "toshiba,tc956x-mac-reset",
						      "toshiba,tc956x-pma-reset",
						      "toshiba,tc956x-xpcs-reset";

					interrupts-extended = <&tc9564_msigen1 2>,
							      <&tc9564_msigen1 3>,
							      <&tc9564_msigen1 4>,
							      <&tc9564_msigen1 5>,
							      <&tc9564_msigen1 6>,
							      <&tc9564_msigen1 7>,
							      <&tc9564_msigen1 8>,
							      <&tc9564_msigen1 9>,
							      <&tc9564_msigen1 10>,
							      <&tc9564_msigen1 11>,
							      <&tc9564_msigen1 12>,
							      <&tc9564_msigen1 13>,
							      <&tc9564_msigen1 14>,
							      <&tc9564_msigen1 15>,
							      <&tc9564_msigen1 16>,
							      <&tc9564_msigen1 17>,
							      <&tc9564_msigen1 18>;
				};
			};
		};
	};
};
